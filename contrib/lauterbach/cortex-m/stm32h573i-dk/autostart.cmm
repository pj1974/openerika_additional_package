; --------------------------------------------------------------------------------
; @Title: Script for STM32H573II on STM32H573I-DK
; @Description:
;   Program or Loads application into MCU internal FLASH or RAM and sets up a
;   debug scenario.
;
; @Copyright: (C) 1989-2026 Lauterbach GmbH
; @Copyright: (C) 2026 Paolo Gai
; Licensed for use with TRACE32(R) only
; --------------------------------------------------------------------------------


LOCAL &hasTracer
; do not change the next line. It is changed by the code generator in case of
; Tracer is selected
&hasTracer=0

IF (&hasTracer==1)&&!(CAnalyzer())
(
  DIALOG.OK "Support for SerialWireViever requires Combiprobe or uTRace."
  ENDDO
)
WinCLEAR

; --------------------------------------------------------------------------------
; initialize and start the debugger

LOCAL &mcuDerivative
; do not change the next line. It is changed by the code generator in case of
; choosen MCU derivative
&mcuDerivative=0

RESet
IF &mcuDerivative==573
(
  SYStem.CPU STM32H573II
)
ELSE
(
  DIALOG.OK "MCU S32K"+FORMAT.DEcimal(3.,&mcuDerivative)+" not supported." 
  ENDDO
)

SYStem.CONFIG.DEBUGPORTTYPE SWD
ETM.OFF
ITM.OFF
Trace.DISable
IF COMBIPROBE()||UTRACE()
(
  SYStem.CONFIG.CONNECTOR MIPI20T
)
SYStem.Option DUALPORT ON
SYStem.Up

LOCAL &execFromRam
; do not change the next line. It is changed by the code generator in case of
; RAM execution
&execFromRam=0

IF &execFromRam==1
(
  ; --------------------------------------------------------------------------------
  ; load demo program (uses internal RAM only)
  Data.LOAD.Elf "~~~~/obj/OpenErikaApp.elf"
)
ELSE
(
  ; --------------------------------------------------------------------------------
  ; Flash programming

  ; prepare flash programming (declarations)
  DO ~~/demo/arm/flash/stm32h5.cmm PREPAREONLY

  ; ReProgram Flash
  FLASH.ReProgram ALL
  Data.LOAD.Elf "~~~~/obj/OpenErikaApp.elf"
  FLASH.ReProgram OFF

  ; --------------------------------------------------------------------------------
  ; Reset the target again
  SYStem.Up
)

IF (&hasTracer==2)
(
  ; --------------------------------------------------------------------------------
  ; initialize OFFCHIP trace (ETM, ITM)
  ; CN18 :
  ;    - TRACECLK : PE2
  ;    - TRACED0 : PE3
  ;    - TRACED1 : PG14
  ;    - TRACED2 : PE5
  ;    - TRACED3 : PE6
  IF COMBIPROBE()||UTRACE()||Analyzer()
  (
    ; set PinMux and enable Clocks

    ; Enable trace in the DBGMCU register
    Data.Set AD:0x44024004 %Long 0yXXXXxxxxXXXXxxxxXXXXxxxx1111xxxx

    ; Enable GPOIE and GPOIG
    Data.Set AD:0x44020C8C %Long 0yXXXXxxxxXXXXxxxxXXXXxxxxX1X1xxxx

    ; PE2 (TRACECLK), PE3 (TRACED0), PE5 (TRACED2) and PE6 (TRACED3) multiplexing
    Data.Set AD:0x42021000 %Long 0yXXXXxxxxXXXXxxxxXX1010xx1010xxxx

    ; PG14 (TRACED1) multiplexing
    Data.Set AD:0x42021800 %Long 0yXX10xxxxXXXXxxxxXXXXxxxxXXXXxxxx

    ; PE2 (TRACECLK), PE3 (TRACED0), PE5 (TRACED2) and PE6 (TRACED3) port speed
    Data.Set AD:0x42021008 %Long 0yXXXXxxxxXXXXxxxxXX1111xx1111xxxx

    ; PG14 (TRACED1) port speed
    Data.Set AD:0x42021808 %Long 0yXX11xxxxXXXXxxxxXXXXxxxxXXXXxxxx

    TPIU.PortSize 4
    TPIU.PortMode Continuous
    ITM.DataTrace CorrelatedData
    ITM.ON
    ETM.Trace ON
    ETM.ON
  )
  IF COMBIPROBE()||UTRACE()
  (
    Trace.METHOD CAnalyzer
    Trace.AutoInit ON
    CAnalyzer.AutoFocus
  )
  IF Analyzer()
  (
    Trace.METHOD Analyzer
    Trace.AutoInit ON
    Trace.AutoFocus
  )
)

LOCAL &hasORTI
; do not change the next line. It is changed by the code generator in case ORTI is selected
&hasORTI=0

IF &hasORTI==1
(
  TASK.ORTI ~~~~/application/gencode/system.orti

  Break.Set TASK.CONFIG(magic) /Write /TraceData
  Break.Set TASK.CONFIG(magic_service) /Write /TraceData

  ; Markers provided by Marco Ferrario
  y.marker.res
  y.marker.c IGNORE osEE_change_context_from_task_end
  y.marker.c IGNORE osEE_cortex_m_change_context_from_task_end
  ; y.marker.c IGNORE osEE_scheduler_task_end
  y.marker.c IGNORE osEE_scheduler_task_wrapper_run
  ;y.marker.c IGNORE osEE_scheduler_task_not_terminated
  y.marker.c IGNORE osEE_scheduler_task_terminated
  y.marker.c IGNORE osEE_scheduler_task_terminated+0x48
  ; y.marker.c IGNORE osEE_cortex_m_switch_context
  ; y.marker.c IGNORE osEE_cortex_m_switch_context+0x0e
  y.marker.c IGNORE osEE_change_context_from_running
  y.marker.c IGNORE osEE_change_context_from_running+26
  y.marker.c IGNORE osEE_scheduler_task_wrapper_restore
  y.marker.c IGNORE osEE_scheduler_core_pop_running
  y.marker.c IGNORE osEE_scheduler_core_pop_running+0x20
  ; y.marker.c IGNORE osEE_scheduler_stk_next
  ; y.marker.c IGNORE osEE_scheduler_stk_next+0x1c
  ; y.marker.c IGNORE osEE_scheduler_core_rq_preempt_stk
  ; y.marker.c IGNORE osEE_scheduler_core_rq_preempt_stk+0x52
  y.marker.c CLEANUP TerminateTask
  ;y.marker.c FEXITDOUBLE SVC_Handler+2
)

IF &hasTracer==1
(
  ; --------------------------------------------------------------------------------
  ; load demo program (uses internal RAM only)
  Data.LOAD.Elf ~~~~/sieve_ram_thumb_ii_v8m_base.elf

  ; --------------------------------------------------------------------------------
  ; initialize SerialWireViewer

  ; Enable trace clock and setup pin multiplexing via DBGMCU register
  Data.Set AD:0x44024004 %Long 0yXXXXxxxxXXXXxxxxXXXXxxxx0011xxxx

  Trace.METHOD CAnalyzer
  Trace.AutoInit ON
  TPIU.PortSize SWV
  ITM.DataTrace ON
  ITM.ON
  ; use auto-calibration script to find most suitable TPIU.SWVPrescaler <divider>
  DO ~~/demo/arm/etc/serial_wire_viewer/swv_autocalibration.cmm
)

; --------------------------------------------------------------------------------
; start program execution
Go.direct main
WAIT !STATE.RUN()

; --------------------------------------------------------------------------------
; open some windows
WinCLEAR
Mode.Hll
WinPOS 0. 0. 116. 26.
List.auto
WinPOS 120. 0. 100. 8.
Frame.view
WinPOS 120. 14.
Var.Watch
IF &hasTracer==1
(
  WinPOS 120. 25.
  ITMTrace.List
)
ELSE IF &hasTracer==2
(
  WinPOS 120. 25.
  Trace.List
)

; Disable automatic breakpoint on Faults
; Let the Execution Escalation to work properly.
TrOnchip.Set HARDERR OFF
TrOnchip.Set MMERR OFF
TrOnchip.Set BUSERR OFF

ENDDO
